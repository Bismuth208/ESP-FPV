## esp_fpv_rx/main/Kconfig
```kconfig
menu "Debug project configuration"
  config ENABLE_DEBUG_TOOLS
    bool "Debug Support"
    default n
    help
      Enable/disable whole debug output

  # if ENABLE_DEBUG_TOOLS
    menu "Debug Items"
      config ENABLE_TASK_START_EVENT_DBG_PRINTOUT
        int "Print what TaskName is started"
        range 0 1
        default 0

      config IMAGE_DECODE_TIME_DBG_PRINTOUT
        int "Print amount of time used by image docoder"
        range 0 1
        default 0

      config OSD_UPDATE_TIME_DBG_PRINTOUT
        int "Tell when OSD being updated"
        range 0 1
        default 0

      config WIFI_RX_PACKET_CB_DBG_PRINTOUT
        int "Tell when wifi_packet_rx_cb is called"
        range 0 1
        default 0
        
      config WIFI_RX_DATA_CB_DBG_PRINTOUT
        int "Dump data wifi_packet_rx_cb is called"
        range 0 1
        default 0

      config ESP_NOW_SEND_PACKET_FAIL_DBG_PRINTOUT
        int "Tell when esp_now_send failed and why"
        range 0 1
        default 0

      config WIRELESS_TELL_SCAN_PROGRESS
        int "Tell collected stats from wireless_scanner"
        range 0 1
        default 0
    endmenu

    # Naming rule:
    #  YOUR_NAME##_DBG_PROFILER
    #  YOUR_NAME##_DBG_PROFILER_POINT_ID
    # NOTE: Point Id Should not be higher than @ref PROFILER_POINTS_MAX
    menu "Profile Items"
      menu "JD_CHUNK_DECODE_TIME_DBG_PROFILER"
        config JD_CHUNK_DECODE_TIME_DBG_PROFILER
          int "Trace time used to decode jpg tile"
          range 0 1
          default 0
        config JD_CHUNK_DECODE_TIME_DBG_PROFILER_POINT_ID
          int "Profile ID"
          range 0 PROFILER_POINTS_MAX
          default 2
      endmenu

      menu "JD_OUTPUT_DBG_PROFILER"
        config JD_OUTPUT_DBG_PROFILER
          int "Trace time used to copy decoded jpg tile"
          range 0 1
          default 0
        config JD_OUTPUT_DBG_PROFILER_POINT_ID
          int "Profile ID"
          range 0 PROFILER_POINTS_MAX
          default 3
      endmenu

      menu "JD_DECODE_DBG_PROFILER"
        config JD_DECODE_DBG_PROFILER
          int "Trace time used to decode jpg image"
          range 0 1
          default 0
        config JD_DECODE_DBG_PROFILER_POINT_ID
          int "Profile ID"
          range 0 PROFILER_POINTS_MAX
          default 4
      endmenu
      
      menu "ESP_NOW_TASK_PACKET_SEND_DBG_PROFILER"
        config ESP_NOW_TASK_PACKET_SEND_DBG_PROFILER
          int "Trace time used by send_new_packet"
          range 0 1
          default 0
        config ESP_NOW_TASK_PACKET_SEND_DBG_PROFILER_POINT_ID
          int "Profile ID"
          range 0 PROFILER_POINTS_MAX
          default 5
      endmenu

      menu "ESP_NOW_RX_DATA_DBG_PROFILER"
        config ESP_NOW_RX_DATA_DBG_PROFILER
          int "Trace time used by wifi_espnow_parse_new_data"
          range 0 1
          default 0
        config ESP_NOW_RX_DATA_DBG_PROFILER_POINT_ID
          int "Profile ID"
          range 0 PROFILER_POINTS_MAX
          default 6
      endmenu
      
      menu "IMG_CHUNK_DRAW_DBG_PROFILER"
        config IMG_CHUNK_DRAW_DBG_PROFILER
          int "Trace time used by draw_img_chunk"
          range 0 1
          default 0
        config IMG_CHUNK_DRAW_DBG_PROFILER_POINT_ID
          int "Profile ID"
          range 0 PROFILER_POINTS_MAX
          default 7
      endmenu
      
      menu "OSD_DRAW_TIME_DBG_PROFILER"
        config OSD_DRAW_TIME_DBG_PROFILER
          int "Trace time used by draw_osd_screen"
          range 0 1
          default 0
        config OSD_DRAW_TIME_DBG_PROFILER_POINT_ID
          int "Profile ID"
          range 0 PROFILER_POINTS_MAX
          default 8
      endmenu

      menu "AES_ENCRYPTION_TIME_DBG_PROFILER"
        config AES_ENCRYPTION_TIME_DBG_PROFILER
          int "Trace time used by Encrypt/Decrypt data"
          range 0 1
          default 0
        config AES_ENCRYPTION_TIME_DBG_PROFILER_POINT_ID
          int "Profile ID"
          range 0 PROFILER_POINTS_MAX
          default 9
      endmenu
    endmenu
  # endif
endmenu
```

## libs/debug_tools_esp/Kconfig
```kconfig
menu "Debug tools config"

  config ASYNC_PRINTF_MAX_ITEMS
    int "Printf items"
    default 512
    help
      Amount of items to be held/stored with buffer.
      Note this value ALWAYS should be the power of 2 for correct work of circular buffer!

  config ASYNC_PRINTF_MAX_OUTPUT_BUF_LEN
    int "Text buffer size"
    default 2048
    help
      Maximum amount of bytes in formatted string to output via UART
  
  config PROFILER_POINTS_MAX
    int "Profile points"
    default 32
    help
      Maximum amount of available independent points to use

  config ASYNC_PRINTF_USE_RTOS
    bool "Use dedicated task for async_printf"
    default y
    help
      If disabled then async_printf_sync must be called within main loop

  if ASYNC_PRINTF_USE_RTOS
    menu "Config for async_printf task"
      config ASSIGNED_TASK_PRINTF_NAME
        string "Name for async_printf task"
        default "task_printf"

      config STACK_WORDS_SIZE_FOR_TASK_PRINTF
        int "Stack size for async_printf task"
        default 2048

      config PRIORITY_LEVEL_FOR_TASK_PRINTF
        int "Priority for async_printf task"
        default 1

      config SYNC_PERIOD_TASK_PRINTF
        int "How often async_printf_sync is called (ms)"
        range 1 1000
        default 1

      choice PINNED_CORE_FOR_TASK_PRINTF
        bool "Core for async_printf task"
        default ASYNC_PRINTF_CORE0
    
        config ASYNC_PRINTF_CORE0
            bool "CORE0"
        config ASYNC_PRINTF_CORE1
            bool "CORE1"
        config ASYNC_PRINTF_NO_AFFINITY
            bool "NO_AFFINITY"
      endchoice
    endmenu
  endif

  menu "System stats print"
    config SYS_STATS_DBG_PRINTOUT
      bool "Print task and CPU usage"
      default n
      help
        This parameter requirer to enable
        at "Component config -> FreeRTOS -> Kernel ->":
          - configUSE_TRACE_FACILITY
          - Enable display of xCoreId in vTaskList
          - configGENERATE_RUN_TIME_STATS

    if SYS_STATS_DBG_PRINTOUT
      config SYS_STATS_BUF_SIZE
        int "Size of text buffer"
        default 8192

      config SYS_STATS_PLOT_TIMEOUT
        int "Stasts print period (ms)"
        default 1000
        help
          How ofted dedicated task will collect 
          and print stats to UART
    endif
  endmenu
endmenu
```
